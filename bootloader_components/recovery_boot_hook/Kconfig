## bootloader_components/recovery_boot_hook/Kconfig
```kconfig
config BOOTLOADER_AI_PASSPORT_QEMU_SKIP_RECOVERY_HOOK
    bool "Skip AI Passport Recovery hold hook in QEMU"
    default n
    help
        QEMU holds GPIO0 in its boot strap state, which otherwise looks like
        the five-second physical UP-key Recovery hold. This option is for the
        isolated QEMU build only and must remain disabled for device firmware.
```

## components/bsp/Kconfig
```kconfig
menu "AI Passport BSP"

config AI_PASSPORT_QEMU
    bool "Use the QEMU virtual RGB panel"
    default n
    help
        Build the same application for Espressif's ESP32-C3 QEMU target.
        This swaps only the physical ST7789P3 transport for QEMU's MMIO-backed
        RGB panel. It must never be enabled for a physical AI Passport.

endmenu
```
